## drivers/power/Kconfig
```kconfig
# SPDX-License-Identifier: GPL-2.0-only
source "drivers/power/reset/Kconfig"
source "drivers/power/supply/Kconfig"

source "drivers/power/oplus/Kconfig"
config OPLUS_CHARGER
	bool "OPLUS_CHARGER"
	default n
	help
	  Set Yes to support OPLUS_CHARGER features
	  smart battery.
	  Set No to disable OPLUS_CHARGER features
	  smart battery.

config OPLUS_CHARGER_MTK
	bool "OPLUS charger on MTK"
	default n
	help
	  Say Yes here to declare charging system is on MTK
	  Say No here to declare charging system is not on MTK

config OPLUS_CHARGER_MTK_CHGIC
	bool "OPLUS_CHARGER_MTK_CHG_IC"
	default n
	help
	  Say Yes to use MTK platform charger ic
	  Say No to use extern charger ic

config OPLUS_CHARGER_MTK6983S
	bool "OPLUS_CHARGER_MTK6983S"
	default n
	help
	  Set yes to support OPLUS_CHARGER_MTK6983S features
	  smart battery.
	  Set No to disable OPLUS_CHARGER_MTK6983S features
	  smart battery.

config OPLUS_CHARGER_MTKAGING
	bool "OPLUS_CHARGER_MTKAGING"
	default n
	help
	  Set yes to support amend mtk aging algo features
	  Set No to disable OPLUS_CHARGER_MTKAGING features

config OPLUS_HVDCP_SUPPORT
        bool "OPLUS_HVDCP_SUPPORT"
        default n
        help
          Set yes to support hvdcp.

config OPLUS_CHECK_CHARGERID_VOLT
	bool "OPLUS_CHECK_CHARGERID_VOLT"
	default n
	help
	  Set yes to support OPLUS_CHECK_CHARGERID_VOLT features
	  smart battery.
	  Set No to disable OPLUS_CHECK_CHARGERID_VOLT features
	  smart battery.

config OPLUS_4400MV_BATTERY_SUPPORT
	bool "OPLUS_CHECK_CHARGERID_VOLT"
	default n
	help
	  Set yes to support BATTERYID features
	  smart battery.
	  Set No to disable BATTERYID features
	  smart battery.

config OPLUS_CALL_MODE_SUPPORT
	bool "OPLUS call mode support"
	default n
	help
	  Say Y to enable support for the oplus call mode.

config OPLUS_CALL_MODE_SUPPORT
	bool "OPLUS call mode support"
	help
	  Say Y to enable support for the oplus call mode.

config OPLUS_SHIP_MODE_SUPPORT
	bool "OPLUS ship mode support"
	default n
	help
	  Say Y to include support

config OPLUS_SHORT_HW_CHECK
	bool "OPLUS batt HW SHORT"
	default n
	help
	  Say Y to include support

config OPLUS_SMART_CHARGER_SUPPORT
        bool "OPLUS Smart Charger support"
        default n
        help
          Say Y to include support

config OPLUS_SHORT_IC_CHECK
	bool "OPLUS batt short "
	help
	  Say Y here to declare charging system is on MTK

config OPLUS_CHG_DYNAMIC_CONFIG
	bool "OPLUS_CHG_DYNAMIC_CONFIG"
	default n
	help
	  Say Y to include support
config MTK_KERNEL_POWER_OFF_CHARGING
	bool "MTK kernel power off charging"
	default n
	help
	  yes : support KPOC feature, power off charging would running by
	  kernel and charging animation by kpoc service. no: not support KPOC
	  feature.
	  device won't enter charging mode if config is no.
```

## drivers/soc/oplus/graphics/Kconfig
```kconfig
# SPDX-License-Identifier: GPL-2.0-only
# Copyright (C) 2020-2022 Oplus. All rights reserved.

config OPLUS_SYNC_FENCE
	tristate "Enable oplus sync fence"
	help
	  Enable sync_fence driver
```

## fs/oplus_perf_fs/Kconfig
```kconfig
# SPDX-License-Identifier: GPL-2.0-only
# Copyright (C) 2018-2020 Oplus. All rights reserved.

config OPLUS_FEATURE_PERFORMANCE_FS
	bool "config oplus kernel fs feature"
	default y
	help
	  define this config to add oplus kernel fs feature
```

## kernel/oplus_perf_sched/Kconfig
```kconfig
# SPDX-License-Identifier: GPL-2.0-only
# Copyright (C) 2018-2020 Oplus. All rights reserved.

config OPLUS_FEATURE_PERFORMANCE_SCHED
	bool "config oplus kernel sched feature"
	default y
	help
	  define this config to add oplus kernel sched feature

config OPLUS_FEATURE_SCHED_ASSIST
	tristate "sched assist"
	default n
	help
	  turning sched for ui, render and so on to improve UX

config OPLUS_FEATURE_SF_BOOST
	tristate "sf boost"
	default n
	help
	  When the util of surfaceflinger is greater than 90,
	  prefer to use big core.

config OPLUS_BINDER_PRIO_SKIP
	tristate "config binder prio skip"
	default n
	depends on OPLUS_FEATURE_PERFORMANCE_SCHED
	help
	  Define this config for skip binder_transaction_priority.
	  When a RT thread A do binder transaction with a cfs thread B,
	  the priority of A will be set to the same as B (cfs).
	  So it will affect the performance of A thread,
	  so skip priority set during binder transaction in some situation.

config OPLUS_FEATURE_HWC_BOOST
	tristate "hwc boost"
	default n
	help
	  When the util of hwc is greater than 51,
	  prefer to use big core.

config OPLUS_FEATURE_HEALTHINFO
	tristate "config healthinfo"
	default n
	depends on OPLUS_FEATURE_PERFORMANCE_SCHED
	help
	  define this config to init  healthinfo.

config OPLUS_FEATURE_TASK_CPUSTATS
	tristate "task_cpustats"
	default n
	help
	  record cpu status

config OPLUS_FEATURE_SCHED_SPREAD
	bool "sched spread"
	default n
	depends on OPLUS_FEATURE_SCHED_ASSIST
	depends on CGROUP_SCHED
	help
	  This is the uifirst 5.0 feature, which will spread tasks,
	  kick runnable time from task demand.

config OPLUS_FEATURE_TASK_SCHED
	tristate "task_sched"
	default n
	depends on OPLUS_FEATURE_SCHED_ASSIST
	help
	  record task sched info

config OPLUS_FEATURE_TASK_LOAD
	tristate "task_load"
	default n
	depends on OPLUS_FEATURE_SCHED_ASSIST
	help
	  record cpu and task load
```
